## platforms/esp32/sdkconfig.defaults
```kconfig
# Q-Lite ESP32-S3 Default Configuration
# This file ensures correct build for ESP32-S3 target

# Chip Configuration
CONFIG_IDF_TARGET_ESP32S3=y
CONFIG_IDF_TARGET="esp32s3"

# XTensa Configuration
CONFIG_ESP32S3_SPIRAM_SUPPORT=y
CONFIG_ESP32S3_SPIRAM_MODE_OCT=y

# WiFi Configuration
CONFIG_ESP_WIFI_STA_RX_BA_WIN=6
CONFIG_ESP_WIFI_DYNAMIC_RX_BUFFER_NUM=32
CONFIG_ESP_WIFI_DYNAMIC_TX_BUFFER_NUM=32

# LwIP Configuration
CONFIG_LWIP_MAX_SOCKETS=10
CONFIG_LWIP_SO_REUSE=y
CONFIG_LWIP_SO_RCVBUF=y

# HTTP Server Configuration
CONFIG_HTTPD_MAX_REQ_HDR_LEN=1024
CONFIG_HTTPD_MAX_URI_LEN=512

# Memory Configuration
CONFIG_ESP_MAIN_TASK_STACK_SIZE=8192
CONFIG_ESP_SYSTEM_EVENT_TASK_STACK_SIZE=4096

# Optimization
CONFIG_OPTIMIZATION_LEVEL_DEBUG=y
# For release builds, use:
# CONFIG_OPTIMIZATION_LEVEL_RELEASE=y
```
